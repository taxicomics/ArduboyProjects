#include <Arduboy2.h>

Arduboy2 arduboy;
BeepPin1 beep;
//img


// Example: Sprites::drawPlusMask(x, y, spaceship, frame);
const uint8_t PROGMEM spaceship[] = {
  16, 16,
  0x00, 0x00, 0x00, 0x00, 0x00, 0x00, 0x80, 0x80, 0xc4, 0xc4, 0xc4, 0xc4,
  0x4e, 0xce, 0x4a, 0xce, 0xee, 0xee, 0xde, 0xfe, 0xde, 0xfe, 0xde, 0xfe,
  0xbe, 0xfe, 0x4a, 0x7e, 0x3c, 0x3c, 0x00, 0x00, 0x00, 0x00, 0x00, 0x00,
  0x00, 0x00, 0x01, 0x01, 0x23, 0x23, 0x23, 0x23, 0x72, 0x73, 0x52, 0x73,
  0x77, 0x77, 0x7b, 0x7f, 0x7b, 0x7f, 0x7b, 0x7f, 0x5d, 0x7f, 0x52, 0x7e,
  0x3c, 0x3c, 0x00, 0x00,
};

const uint8_t PROGMEM enemy1[] = {
  8, 8,
  0x18, 0x18, 0x24, 0x3c, 0x5a, 0x7e, 0x66, 0x7e, 0x5a, 0x5a, 0x5a, 0x5a,
  0x18, 0x18, 0x00, 0x00,
};


const uint8_t PROGMEM GameOverScreen[] = {
  128, 64,
  0x01, 0xfc, 0x02, 0xfa, 0x0a, 0x2a, 0x0a, 0x0a, 0x0a, 0x0a, 0x0a, 0x0a,
  0x0a, 0x0a, 0x0a, 0x0a, 0x0a, 0x0a, 0x0a, 0x0a, 0x0a, 0x0a, 0x0a, 0x0a,
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  0x4f, 0x40, 0x3f, 0x80,
};

// 128x64, 1 frame(s), 1026 bytes
// Example: Sprites::drawOverwrite(x, y, MenuScreen, frame);
const uint8_t PROGMEM MenuScreen[] = {
  128, 64,
  0x01, 0xfc, 0x02, 0xfa, 0x0a, 0x2a, 0x0a, 0x0a, 0x0a, 0x0a, 0x0a, 0x0a,
  0x0a, 0x0a, 0x8a, 0xca, 0xca, 0xca, 0xca, 0xca, 0xca, 0xca, 0xca, 0xca,
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  0x5f, 0x40, 0x3f, 0x80,
};

const uint8_t PROGMEM heart[] = {
  8, 8,
  0x1e, 0x1e, 0x3f, 0x3f, 0x7f, 0x7f, 0xfe, 0xfe, 0xfe, 0xfe, 0x7f, 0x7f,
  0x3f, 0x3f, 0x1e, 0x1e,
};
//CONSTS
const int SHOT_TABLE_SIZE=20;
const int PLAYER_SHOT_CD_VALUE=15;
const int ENEMY_TABLE_SIZE=2;
const int PLAYER_INV_CD_VALUE=50;
const int ENEMY_SHOT_DISTANCE=7;
const int PLAYER_SHOT_DISTANCE=15;
const int ENEMY_SPAWN_CD_VALUE=100;
//vars
int player_x=110;
int player_y=24;
int player_shot_cd=0;
int player_inv_cd=0;
int enemy_spawn_cd=0;
int player_score=0;
int player_hp=5;
float time=0.0;
int state=0;
boolean did_star_offset=false;
//XXXXXXXXXXXXXXXXXXXXXXXXXXXXXXXXXXXXXXXXXXXXXXXXXXXXXXXXXXXXXXXXXXXXXXXXX
// HELPERS
//XXXXXXXXXXXXXXXXXXXXXXXXXXXXXXXXXXXXXXXXXXXXXXXXXXXXXXXXXXXXXXXXXXXXXXXXX
void print(String text,int x, int y){
  arduboy.setCursor(x, y);
  arduboy.println(text);
}

//void spr(int x, int y){
 // Sprites::drawPlusMask(x, y, spaceship, 0);
//}

void spr(const uint8_t *bitmap,int x, int y){
  Sprites::drawPlusMask(x, y, bitmap, 0);
}

void playTone(uint16_t count, uint8_t frames)
{
  beep.tone(count, frames);
}

int distance(int x1,int y1, int x2, int y2){
  return abs(x1-x2)+abs(y1-y2);
}
//XXXXXXXXXXXXXXXXXXXXXXXXXXXXXXXXXXXXXXXXXXXXXXXXXXXXXXXXXXXXXXXXXXXXXXXXX
// Classes
//XXXXXXXXXXXXXXXXXXXXXXXXXXXXXXXXXXXXXXXXXXXXXXXXXXXXXXXXXXXXXXXXXXXXXXXXX
class Enemy{
  public:
    float x=-16;
    int y=500;
    float xs=.5;
    int player_hp=5;
    void update(){
      if (y<128){
        x+=xs;
      }
      if (x>200){
        x=-16+random(-32,0);
        y=random(3,46);
      }
      if ((player_x<x) && (player_x+16>x) && (player_y<y) && (player_y+16>y) ){
        hurt_player(1);
        y=500;
        //player_score+=15;
      }

    }
    Enemy(){
      y=random(3,46);
    }
    void draw(){
      spr(enemy1,x,y);
    }
};
Enemy my_enemies[ENEMY_TABLE_SIZE];

class Shot{
  public:
    float x=5;
    float y=500;
    float xs=0;
    float ys=0;
    void draw(){
      arduboy.fillCircle(x, y, 1, WHITE);
    }
    void update(){
      x+=xs;
      y+=ys;
      if ((x<0) || (x>128)){
        y=500;
      }
      for (int i=0;i<ENEMY_TABLE_SIZE;i++){
        if (distance(my_enemies[i].x,my_enemies[i].y,x,y)<ENEMY_SHOT_DISTANCE){
          my_enemies[i].y=500;
          y=500;
        }
      }
      if ((distance(player_x,player_y,x,y)<PLAYER_SHOT_DISTANCE) && (xs>0)){
        hurt_player(1);
      }
    }
};

Shot my_shot[SHOT_TABLE_SIZE];

//classes
class StarMaker {
  public:
    int x=12;
    int y=12;
    int xs=2;
    void update(){
      x+=xs;
      if (x>128){
        x-=128;
      }
    }
};
StarMaker stars[10];

//XXXXXXXXXXXXXXXXXXXXXXXXXXXXXXXXXXXXXXXXXXXXXXXXXXXXXXXXXXXXXXXXXXXXXXXXX
// MAIN FUNCTIONS
//XXXXXXXXXXXXXXXXXXXXXXXXXXXXXXXXXXXXXXXXXXXXXXXXXXXXXXXXXXXXXXXXXXXXXXXXX
void setup()
{
  arduboy.begin();
  beep.begin();
  arduboy.setFrameRate(60);
  arduboy.initRandomSeed();
  new_enemy(-16,random(3,48));
  new_enemy(-16,random(3,48));
}

void loop() {
    if (!(arduboy.nextFrame()))
    return;
    time+=.01;
    // Handle the timing and stopping of tones
    beep.timer();
    arduboy.clear();
    if (state==0){
      drawMainMenu();
      updateMainMenu();
    }
    if (state==1){
      drawGame();
      updateGame();
    }
    if (state==2){
      drawGameOver();
      updateGameOver();
    }
    arduboy.display();
}
//XXXXXXXXXXXXXXXXXXXXXXXXXXXXXXXXXXXXXXXXXXXXXXXXXXXXXXXXXXXXXXXXXXXXXXXXX
// GAME OVER
//XXXXXXXXXXXXXXXXXXXXXXXXXXXXXXXXXXXXXXXXXXXXXXXXXXXXXXXXXXXXXXXXXXXXXXXXX
void initGameOver() {
  state=2;
}

void drawGameOver() {
  Sprites::drawOverwrite(0,0, GameOverScreen, 0);
}

void updateGameOver(){

}
//XXXXXXXXXXXXXXXXXXXXXXXXXXXXXXXXXXXXXXXXXXXXXXXXXXXXXXXXXXXXXXXXXXXXXXXXX
// MAIN MENU
//XXXXXXXXXXXXXXXXXXXXXXXXXXXXXXXXXXXXXXXXXXXXXXXXXXXXXXXXXXXXXXXXXXXXXXXXX
void drawMainMenu() {
  Sprites::drawOverwrite(0,0, MenuScreen, 0);
}

void updateMainMenu() {
  if (arduboy.pressed(A_BUTTON)){
      initGame();
  }
}
//XXXXXXXXXXXXXXXXXXXXXXXXXXXXXXXXXXXXXXXXXXXXXXXXXXXXXXXXXXXXXXXXXXXXXXXXX
// GAME
//XXXXXXXXXXXXXXXXXXXXXXXXXXXXXXXXXXXXXXXXXXXXXXXXXXXXXXXXXXXXXXXXXXXXXXXXX
void initGame() {
  state=1;
}

void drawGame() {
  drawStars();
  for (int i=0;i<SHOT_TABLE_SIZE;i++){
    my_shot[i].draw();
  }
   for (int i=0;i<ENEMY_TABLE_SIZE;i++){
    my_enemies[i].draw();
  }
  if ((player_inv_cd==0)||(player_inv_cd%10>5)){
    spr(spaceship,player_x,player_y);
  }
  arduboy.drawRect( 1,1,126, 62, WHITE);
  arduboy.drawRect( 0,0,128, 64, BLACK);
  //print("Score: "+player_score,3,3);
  for (int i=0; i<player_hp;i++){
    spr(heart,3+i*9,53);
  }
}

void updateGame(){
  //enemies
  for (int i=0;i<SHOT_TABLE_SIZE;i++){
    my_shot[i].update();
  }
   for (int i=0;i<ENEMY_TABLE_SIZE;i++){
    my_enemies[i].update();
  }
  //controls
  if ((arduboy.pressed(DOWN_BUTTON)) && (player_y<46)){
    player_y+=1;
  }
  if ((arduboy.pressed(UP_BUTTON)) && (player_y>2)){
    player_y-=1;
  }
  if ((arduboy.pressed(A_BUTTON)) && (player_shot_cd==0)){
    shoot(player_x,player_y+8,-1,0);
  }
  if(player_shot_cd>0){
    player_shot_cd-=1;
  }
  if(player_inv_cd>0){
    player_inv_cd-=1;
  }
  //rules
  if (player_hp<=0){
    initGameOver();
  }
  if (enemy_spawn_cd==0){
    enemy_spawn_cd=ENEMY_SPAWN_CD_VALUE;
    new_enemy(-16,random(3,48));
  }
  else{
    enemy_spawn_cd-=1;
  }
}

//XXXXXXXXXXXXXXXXXXXXXXXXXXXXXXXXXXXXXXXXXXX
//more helpers
//XXXXXXXXXXXXXXXXXXXXXXXXXXXXXXXXXXXXXXXXXXX
void drawStars(){
  if (did_star_offset==false){
    for (int i = 0; i<10;i++) {
      stars[i].x=random(0,128);
      stars[i].y=i*5;
    }
    did_star_offset=true;
  }
  for (int i = 0; i<10;i++) {
    arduboy.drawPixel(stars[i].x,stars[i].y,WHITE);
    stars[i].update();
  }
}

void shoot(int x,int y,float xs,float ys){
   for (int i=0;i<SHOT_TABLE_SIZE;i++){
    if (my_shot[i].y==500){
      my_shot[i].y=y;
      my_shot[i].x=x;
      my_shot[i].xs=xs;
      my_shot[i].ys=ys;
      player_shot_cd=PLAYER_SHOT_CD_VALUE;
      return;
    }
  }
}

void new_enemy(int x,int y){
   for (int i=0;i<ENEMY_TABLE_SIZE;i++){
    if (my_enemies[i].y==500){
      my_enemies[i].y=y;
      my_enemies[i].x=x;
      return;
    }
  }
}

boolean hurt_player(int dmg){
  if (player_inv_cd==0){
    player_inv_cd=PLAYER_INV_CD_VALUE;
    playTone(2,2);
    player_hp-=1;
  }
  return true;
}

